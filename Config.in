## Config.in
```kconfig
source "$NERVES_DEFCONFIG_DIR/package/arduino-router/Config.in"
source "$NERVES_DEFCONFIG_DIR/package/mkbootimg/Config.in.host"
source "$NERVES_DEFCONFIG_DIR/package/qrtr/Config.in"
source "$NERVES_DEFCONFIG_DIR/package/rmtfs/Config.in"
source "$NERVES_DEFCONFIG_DIR/package/tqftpserv/Config.in"
source "$NERVES_DEFCONFIG_DIR/package/uno-q-firmware/Config.in"
source "$NERVES_DEFCONFIG_DIR/package/uno-q-mcu/Config.in"
source "$NERVES_DEFCONFIG_DIR/package/uno-q-openocd/Config.in"
```

## nerves_defconfig
```kconfig
BR2_aarch64=y
BR2_cortex_a53=y
BR2_TOOLCHAIN_EXTERNAL=y
BR2_TOOLCHAIN_EXTERNAL_CUSTOM=y
BR2_TOOLCHAIN_EXTERNAL_DOWNLOAD=y
BR2_TOOLCHAIN_EXTERNAL_URL="https://github.com/nerves-project/toolchains/releases/download/v15.3.0/nerves_toolchain_aarch64_nerves_linux_gnu-linux_${shell uname -m}-15.3.0-8DAF9F3.tar.xz"
BR2_TOOLCHAIN_EXTERNAL_CUSTOM_PREFIX="aarch64-nerves-linux-gnu"
BR2_TOOLCHAIN_EXTERNAL_GCC_15=y
BR2_TOOLCHAIN_EXTERNAL_HEADERS_6_0=y
BR2_TOOLCHAIN_EXTERNAL_CUSTOM_GLIBC=y
# BR2_TOOLCHAIN_EXTERNAL_INET_RPC is not set
BR2_TOOLCHAIN_EXTERNAL_CXX=y
BR2_TOOLCHAIN_EXTERNAL_FORTRAN=y
BR2_TOOLCHAIN_EXTERNAL_OPENMP=y
BR2_TAR_OPTIONS="--no-same-owner"
BR2_BACKUP_SITE="https://dl.nerves-project.org"
BR2_ENABLE_DEBUG=y
BR2_GLOBAL_PATCH_DIR="${BR2_EXTERNAL_NERVES_PATH}/patches"
BR2_REPRODUCIBLE=y
BR2_ROOTFS_SKELETON_CUSTOM=y
BR2_ROOTFS_SKELETON_CUSTOM_PATH="${BR2_EXTERNAL_NERVES_PATH}/board/nerves-common/skeleton"
BR2_INIT_NONE=y
BR2_ROOTFS_DEVICE_TABLE="${BR2_EXTERNAL_NERVES_PATH}/board/nerves-common/device_table.txt"
BR2_ENABLE_LOCALE_WHITELIST="locale-archive"
BR2_GENERATE_LOCALE="en_US.UTF-8"
BR2_ROOTFS_OVERLAY="${BR2_EXTERNAL_NERVES_PATH}/board/nerves-common/rootfs_overlay ${NERVES_DEFCONFIG_DIR}/rootfs_overlay"
BR2_ROOTFS_POST_BUILD_SCRIPT="${BR2_EXTERNAL_NERVES_PATH}/board/nerves-common/post-build.sh ${NERVES_DEFCONFIG_DIR}/post-build.sh"
BR2_ROOTFS_POST_IMAGE_SCRIPT="${NERVES_DEFCONFIG_DIR}/post-createfs.sh"
BR2_LINUX_KERNEL=y
BR2_LINUX_KERNEL_CUSTOM_VERSION=y
BR2_LINUX_KERNEL_CUSTOM_VERSION_VALUE="7.2.13"
BR2_LINUX_KERNEL_USE_ARCH_DEFAULT_CONFIG=y
BR2_LINUX_KERNEL_CONFIG_FRAGMENT_FILES="${NERVES_DEFCONFIG_DIR}/linux/nerves.fragment"
BR2_LINUX_KERNEL_DTS_SUPPORT=y
BR2_LINUX_KERNEL_INTREE_DTS_NAME="qcom/qrb2210-arduino-imola"
BR2_LINUX_KERNEL_NEEDS_HOST_OPENSSL=y
BR2_PACKAGE_BUSYBOX_CONFIG="${BR2_EXTERNAL_NERVES_PATH}/board/nerves-common/busybox.config"
BR2_PACKAGE_BUSYBOX_CONFIG_FRAGMENT_FILES="${NERVES_DEFCONFIG_DIR}/busybox.fragment"
BR2_PACKAGE_F2FS_TOOLS=y
BR2_PACKAGE_CA_CERTIFICATES=y
BR2_PACKAGE_LIBP11=y
BR2_PACKAGE_UNIXODBC=y
BR2_PACKAGE_CAIRO=y
BR2_PACKAGE_DTC=y
BR2_PACKAGE_DTC_PROGRAMS=y
BR2_PACKAGE_LIBMNL=y
BR2_PACKAGE_WIRELESS_REGDB=y
BR2_PACKAGE_WPA_SUPPLICANT=y
BR2_PACKAGE_WPA_SUPPLICANT_AP_SUPPORT=y
BR2_PACKAGE_WPA_SUPPLICANT_HOTSPOT=y
BR2_PACKAGE_WPA_SUPPLICANT_DEBUG_SYSLOG=y
BR2_PACKAGE_WPA_SUPPLICANT_WPA3=y
BR2_PACKAGE_WPA_SUPPLICANT_CTRL_IFACE=y
BR2_TARGET_UBOOT=y
BR2_TARGET_UBOOT_BUILD_SYSTEM_KCONFIG=y
BR2_TARGET_UBOOT_CUSTOM_GIT=y
BR2_TARGET_UBOOT_CUSTOM_REPO_URL="https://github.com/arduino/u-boot.git"
BR2_TARGET_UBOOT_CUSTOM_REPO_VERSION="8008ca96a4dc53ddb3e51b96ea7e86d881ab7969"
BR2_TARGET_UBOOT_BOARD_DEFCONFIG="qcom"
BR2_TARGET_UBOOT_CONFIG_FRAGMENT_FILES="${NERVES_DEFCONFIG_DIR}/uboot/uboot.fragment"
BR2_TARGET_UBOOT_NEEDS_DTC=y
BR2_TARGET_UBOOT_NEEDS_PYLIBFDT=y
BR2_TARGET_UBOOT_NEEDS_PYELFTOOLS=y
BR2_TARGET_UBOOT_NEEDS_OPENSSL=y
BR2_TARGET_UBOOT_NEEDS_GNUTLS=y
BR2_TARGET_UBOOT_NEEDS_XXD=y
# BR2_TARGET_UBOOT_FORMAT_BIN is not set
BR2_TARGET_UBOOT_FORMAT_CUSTOM=y
BR2_TARGET_UBOOT_FORMAT_CUSTOM_NAME="u-boot-nodtb.bin"
BR2_PACKAGE_HOST_UBOOT_TOOLS=y
BR2_PACKAGE_HOST_UBOOT_TOOLS_ENVIMAGE=y
BR2_PACKAGE_HOST_UBOOT_TOOLS_ENVIMAGE_SOURCE="${NERVES_DEFCONFIG_DIR}/uboot/uboot.env"
BR2_PACKAGE_HOST_UBOOT_TOOLS_ENVIMAGE_SIZE="131072"
BR2_PACKAGE_ARDUINO_ROUTER=y
BR2_PACKAGE_HOST_MKBOOTIMG=y
BR2_PACKAGE_QRTR=y
BR2_PACKAGE_RMTFS=y
BR2_PACKAGE_TQFTPSERV=y
BR2_PACKAGE_UNO_Q_FIRMWARE=y
BR2_PACKAGE_UNO_Q_MCU=y
BR2_PACKAGE_UNO_Q_OPENOCD=y
BR2_NERVES_SYSTEM_NAME="nerves_system_arduino_uno_q"
BR2_PACKAGE_NBTTY=y
BR2_PACKAGE_NERVES_CONFIG=y
BR2_PACKAGE_NERVES_CONFIG_ACCEPT_RNG_NOTICE=y
```

## package/arduino-router/Config.in
```kconfig
config BR2_PACKAGE_ARDUINO_ROUTER
	bool "arduino-router"
	depends on BR2_PACKAGE_HOST_GO_TARGET_ARCH_SUPPORTS
	help
	  Arduino's MsgPack-RPC router. It owns the serial link to the
	  UNO Q's STM32U585 MCU (/dev/ttyHS1) and lets Linux programs
	  call methods the MCU sketch provides, and vice versa, over a
	  Unix socket.

	  https://github.com/arduino/arduino-router
```

## package/mkbootimg/Config.in.host
```kconfig
config BR2_PACKAGE_HOST_MKBOOTIMG
	bool "host mkbootimg"
	help
	  Android Open Source Project tool for creating Android boot
	  images. Qualcomm's ABL bootloader loads U-Boot from one.

	  https://android.googlesource.com/platform/system/tools/mkbootimg
```

## package/qrtr/Config.in
```kconfig
config BR2_PACKAGE_QRTR
	bool "qrtr"
	help
	  Userspace library and tools for the Qualcomm IPC Router
	  (QRTR) protocol, used to talk to services on Qualcomm
	  remote processors. The name service runs in the kernel.

	  https://github.com/linux-msm/qrtr
```

## package/rmtfs/Config.in
```kconfig
config BR2_PACKAGE_RMTFS
	bool "rmtfs"
	depends on BR2_TOOLCHAIN_HAS_THREADS
	select BR2_PACKAGE_QRTR
	help
	  Qualcomm remote filesystem service. Serves the modem's
	  persistent storage partitions (modemst1, modemst2, fsg) to
	  the modem and starts the modem remote processor once ready.

	  https://github.com/linux-msm/rmtfs
```

## package/tqftpserv/Config.in
```kconfig
config BR2_PACKAGE_TQFTPSERV
	bool "tqftpserv"
	select BR2_PACKAGE_QRTR
	help
	  TFTP server over QRTR. Qualcomm remote processors fetch
	  firmware files through it, e.g. the WCN3990 WiFi firmware
	  loaded by the modem.

	  https://github.com/linux-msm/tqftpserv
```

## package/uno-q-firmware/Config.in
```kconfig
config BR2_PACKAGE_UNO_Q_FIRMWARE
	bool "uno-q-firmware"
	select BR2_PACKAGE_LINUX_FIRMWARE
	help
	  The linux-firmware files for the Arduino UNO Q's Qualcomm
	  QRB2210: Adreno 702 GPU, ADSP and modem remote processors,
	  WCN3990 WiFi and WCN3988 Bluetooth.
```

## package/uno-q-mcu/Config.in
```kconfig
config BR2_PACKAGE_UNO_Q_MCU
	bool "uno-q-mcu"
	depends on BR2_PACKAGE_UNO_Q_OPENOCD
	help
	  Tools for the UNO Q's STM32U585 MCU: the unoq-mcu flashing
	  script and the Nerves logo boot animation for the MCU's
	  LED matrix.

comment "uno-q-mcu needs uno-q-openocd"
	depends on !BR2_PACKAGE_UNO_Q_OPENOCD
```

## package/uno-q-openocd/Config.in
```kconfig
config BR2_PACKAGE_UNO_Q_OPENOCD
	bool "uno-q-openocd"
	depends on BR2_TOOLCHAIN_HEADERS_AT_LEAST_5_10 # libgpiod2
	depends on !BR2_PACKAGE_OPENOCD
	select BR2_PACKAGE_LIBGPIOD2
	help
	  OpenOCD from git, for flashing the UNO Q's STM32U585 over
	  SWD bit-banged from the QRB2210's GPIOs.

	  Buildroot's OpenOCD 0.12.0 only supports libgpiod v1, which
	  needs the deprecated GPIO character device v1 ABI. Released
	  OpenOCD has no libgpiod v2 support yet.

	  https://openocd.org
```
